/dts-v1/;
/plugin/;

/ {
    compatible = "xunlong,orangepi-zero3";

    fragment@0 {
        target-path = "/display-engine";
        __overlay__ {
            status = "disabled";
        };
    };
};