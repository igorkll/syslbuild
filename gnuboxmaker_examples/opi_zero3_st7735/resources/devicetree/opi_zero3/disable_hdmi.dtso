/dts-v1/;
/plugin/;

/ {
    compatible = "xunlong,orangepi-zero3";

    fragment@0 {
        target-path = "/soc/display-engine";
        __overlay__ {
            status = "disabled";
        };
    };
};